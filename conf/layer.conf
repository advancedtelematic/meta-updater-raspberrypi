## conf/layer.conf
```bitbake
# We have a conf and classes directory, add to BBPATH
BBPATH =. "${LAYERDIR}:"

# We have recipes-* directories, add to BBFILES
BBFILES += "${LAYERDIR}/recipes-*/*/*.bb \
            ${LAYERDIR}/recipes-*/*/*.bbappend"

BBFILE_COLLECTIONS += "updater-raspberrypi"
BBFILE_PATTERN_updater-raspberrypi = "^${LAYERDIR}/"
BBFILE_PRIORITY_updater-raspberrypi = "7"

LAYERDEPENDS_updater-raspberrypi = "sota"
LAYERDEPENDS_updater-raspberrypi += "raspberrypi"
LAYERSERIES_COMPAT_updater-raspberrypi = "dunfell"

RPI_WIFI_ENABLE ?= "0"
IMAGE_INSTALL_append += "${@ ' wifi-systemd-service ' if d.getVar('RPI_WIFI_ENABLE') == '1' else ''}"
```
